## CMakeLists.txt
```
cmake_minimum_required(VERSION 3.20.0)
find_package(Zephyr REQUIRED HINTS $ENV{ZEPHYR_BASE})
project(button_status_display)

file(GLOB app_sources CONFIGURE_DEPENDS src/*.c)
target_sources(app PRIVATE ${app_sources})
```

## prj.conf
```kconfig
CONFIG_GPIO=y
CONFIG_I2C=y
CONFIG_SPI=y
CONFIG_ADC=y
CONFIG_CBPRINTF_FP_SUPPORT=y
CONFIG_BOOT_BANNER=n
```

## src/main.c
```c
#include <zephyr/kernel.h>
#include <zephyr/drivers/gpio.h>
#include <zephyr/sys/printk.h>

static const struct device *const button_port = DEVICE_DT_GET(DT_NODELABEL(gpio1));

int main(void)
{
	int was_pressed = 0;

	gpio_pin_configure(button_port, 11, GPIO_INPUT);
	while (1) {
		int pressed = gpio_pin_get(button_port, 11);

		if (pressed && !was_pressed) {
			printk("Button Pressed!\n");
		}
		was_pressed = pressed;
		k_msleep(5);
	}
	return 0;
}
```
